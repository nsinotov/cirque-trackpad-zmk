## config/boards/shields/cirque_trackpad/Kconfig.defconfig
```kconfig
if SHIELD_CIRQUE_TRACKPAD

config ZMK_KEYBOARD_NAME
    default "Cirque Trackpad"

config ZMK_POINTING
    default y

endif
```

## config/boards/shields/cirque_trackpad/Kconfig.shield
```kconfig
config SHIELD_CIRQUE_TRACKPAD
    def_bool $(shields_list_contains,cirque_trackpad)
```
